## crates/net/netstack3-port-spike/kernel-provider/production/rust-abi5/Kconfig
```kconfig
config NETSTACK3_RUST
	bool "Rust userspace-backed Internet socket frontend (ABI5)"
	depends on NET && !INET && RUST && !NETSTACK3 && !NETSTACK3_RUST_LIFECYCLE
	help
	  AF_INET and AF_INET6 delegated to Netstack3 over ABI5. All frontend
	  state and protocol handling is Rust; Linux registration uses C glue.
	  Native loopback and MPLS routing are excluded. Userspace owns interface
	  configuration; Linux retains socket, namespace and IPC mechanics.
```

## crates/net/netstack3-port-spike/kernel-provider/production/rust-lifecycle/Kconfig
```kconfig
config NETSTACK3_RUST_LIFECYCLE
	bool "Experimental Rust Internet socket lifetime slice"
	depends on NET && !INET && RUST
	depends on !NETSTACK3
	help
	  KVM-only feasibility experiment: Rust owns admission, readiness and
	  provider generations and poll waits; C adapts Linux socket/FD callbacks.
	  No TCP/UDP data path. Not a production replacement for NETSTACK3.
```

## crates/netstack3-port-spike/kernel-provider/production/Kconfig
```kconfig
config NETSTACK3
	bool "Userspace-backed Internet sockets"
	depends on NET && !INET
	help
	  Provide AF_INET and AF_INET6 sockets through a scoped userspace
	  transport provider. Native TCP/IP is not built. Provider loss fails
	  sockets closed; localhost is not a separate backend.
```
